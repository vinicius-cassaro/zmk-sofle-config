## Kconfig
```kconfig
menuconfig EYELASH_SOFLE_STATUS_LEDS
    bool "Eyelash Sofle status LED overlays"
    depends on ZMK_RGB_UNDERGLOW
    select ZMK_HID_INDICATORS
    default y if SHIELD_EYELASH_SOFLE_LEFT
    help
      Overlay Caps Lock, Bluetooth profile, and battery status on the
      configured RGB groups without replacing the normal underglow frame.

if EYELASH_SOFLE_STATUS_LEDS

config EYELASH_SOFLE_STATUS_LED_PERIOD_MS
    int "Status LED animation period (milliseconds)"
    default 100
    range 25 1000

endif
```

## dts/bindings/behaviors/zmk,behavior-eyelash-status-led.yaml
```yaml
description: Eyelash Sofle status LED display behavior

compatible: "zmk,behavior-eyelash-status-led"

include: zero_param.yaml

properties:
  action:
    type: int
    required: true
    description: 0 displays Bluetooth profile status; 1 displays battery status.
```

## dts/bindings/eyelash,status-leds.yaml
```yaml
description: LED groups used by Eyelash Sofle status indicators

compatible: "eyelash,status-leds"

properties:
  six-led-index:
    type: int
    required: true
  zero-led-index:
    type: int
    required: true
  one-led-index:
    type: int
    required: true
  two-led-index:
    type: int
    required: true
  three-led-index:
    type: int
    required: true
  four-led-index:
    type: int
    required: true
  five-led-index:
    type: int
    required: true
```
